/dts-v1/;

/ {

	__fixups__ {
		accdet = "/fragment@21:target:0";
		auxadc = "/fragment@3/__overlay__:io-channels:0", "/fragment@30:target:0", "/fragment@31/__overlay__:io-channels:0";
		board_id = "/fragment@3:target:0";
		charger = "/fragment@18:target:0";
		chosen = "/fragment@1:target:0";
		consys = "/fragment@25:target:0";
		dsi_te = "/fragment@50:target:0";
		flashlights_led191 = "/fragment@5:target:0";
		goodix_fp = "/fragment@12:target:0", "/fragment@45:target:0";
		gpio = "/fragment@43:target:0";
		gpio_usage_mapping = "/fragment@42:target:0";
		i2c0 = "/fragment@20:target:0", "/fragment@33:target:0";
		i2c1 = "/fragment@34:target:0";
		i2c2 = "/fragment@19:target:0", "/fragment@35:target:0";
		i2c3 = "/fragment@9:target:0", "/fragment@36:target:0";
		i2c4 = "/fragment@37:target:0";
		i2c5 = "/fragment@38:target:0";
		i2c6 = "/fragment@39:target:0";
		i2c7 = "/fragment@14:target:0", "/fragment@15:target:0", "/fragment@16:target:0", "/fragment@40:target:0";
		i2c8 = "/fragment@41:target:0";
		irq_nfc = "/fragment@46:target:0";
		irtx_pwm = "/fragment@26:target:0";
		kd_camera_hw1 = "/fragment@63:target:0", "/fragment@67:target:0";
		keypad = "/fragment@65:target:0";
		lk_charger = "/fragment@17:target:0";
		main_pmic = "/fragment@53:target:0";
		md1_sim1_hot_plug_eint = "/fragment@54:target:0";
		md1_sim2_hot_plug_eint = "/fragment@55:target:0";
		md_auxadc = "/fragment@31:target:0";
		mt6370_pmu = "/fragment@22:target:0";
		mt6370_typec = "/fragment@23:target:0";
		mt_charger = "/fragment@4:target:0";
		mt_pmic_vcama1_ldo_reg = "/fragment@56:target:0", "/fragment@63/__overlay__:vcama_main2-supply:0", "/fragment@67/__overlay__:cam2_vcama-supply:0";
		mt_pmic_vcama2_ldo_reg = "/fragment@57:target:0", "/fragment@63/__overlay__:vcama_sub-supply:0", "/fragment@63/__overlay__:vcama_sub2-supply:0", "/fragment@63/__overlay__:vcama_main3-supply:0", "/fragment@67/__overlay__:cam3_vcama-supply:0", "/fragment@67/__overlay__:cam4_vcama-supply:0";
		mt_pmic_vcamd_ldo_reg = "/fragment@60:target:0", "/fragment@63/__overlay__:vcamd_main2-supply:0", "/fragment@63/__overlay__:vcamd_sub-supply:0", "/fragment@63/__overlay__:vcamd-supply:0", "/fragment@63/__overlay__:vcamd_main3-supply:0", "/fragment@67/__overlay__:cam0_vcamd-supply:0", "/fragment@67/__overlay__:cam1_vcamd-supply:0", "/fragment@67/__overlay__:cam2_vcamd-supply:0", "/fragment@67/__overlay__:cam4_vcamd-supply:0";
		mt_pmic_vcamio_ldo_reg = "/fragment@61:target:0", "/fragment@63/__overlay__:vcamio-supply:0", "/fragment@63/__overlay__:vcamio_sub-supply:0", "/fragment@63/__overlay__:vcamio_main2-supply:0", "/fragment@63/__overlay__:vcamio_sub2-supply:0", "/fragment@63/__overlay__:vcamio_main3-supply:0", "/fragment@67/__overlay__:cam0_vcamio-supply:0", "/fragment@67/__overlay__:cam1_vcamio-supply:0", "/fragment@67/__overlay__:cam2_vcamio-supply:0", "/fragment@67/__overlay__:cam3_vcamio-supply:0", "/fragment@67/__overlay__:cam4_vcamio-supply:0";
		mt_pmic_vldo28_ldo_reg = "/fragment@62:target:0", "/fragment@63/__overlay__:vcamaf-supply:0", "/fragment@64/__overlay__:vtouch-supply:0", "/fragment@67/__overlay__:cam0_vcamaf-supply:0";
		mt_pmic_vsim1_ldo_reg = "/fragment@58:target:0";
		mt_pmic_vsim2_ldo_reg = "/fragment@59:target:0";
		mtkfb = "/fragment@29:target:0";
		odm = "/fragment@2:target:0";
		pio = "/fragment@3/__overlay__:hw_id-gpios:0", "/fragment@3/__overlay__:board_id2-gpios:0", "/fragment@3/__overlay__:board_id3-gpios:0", "/fragment@4/__overlay__:interrupt-parent:0", "/fragment@4/__overlay__:reverse-gpio:0", "/fragment@6:target:0", "/fragment@8:target:0", "/fragment@9/__overlay__/nxp@28:nq-irq:0", "/fragment@9/__overlay__/nxp@28:interrupt-parent:0", "/fragment@9/__overlay__/nxp@28:nq-ven:0", "/fragment@9/__overlay__/nxp@28:nq-firm:0", "/fragment@9/__overlay__/nxp@28:nq-clkreq:0", "/fragment@12/__overlay__:fpc,gpio_irq:0", "/fragment@13:target:0", "/fragment@14/__overlay__/aw87519@58:reset-gpio:0", "/fragment@15/__overlay__/fusb303@21:interrupt-parent:0", "/fragment@15/__overlay__/fusb303@21:fusb303,int-gpio:0", "/fragment@16/__overlay__/smb1351-charger@55:interrupt-parent:0", "/fragment@20/__overlay__/lm3697@36:enable-gpios:0", "/fragment@22/__overlay__:mt6370,intr_gpio:0", "/fragment@23/__overlay__:mt6370pd,intr_gpio:0", "/fragment@23/__overlay__:mt6370pd,usb_switch_gpio:0", "/fragment@24:target:0", "/fragment@27:target:0", "/fragment@28:target:0", "/fragment@42/__overlay__:GPIO_FDD_BAND_SUPPORT_DETECT_2ND_PIN:0", "/fragment@42/__overlay__:GPIO_FDD_BAND_SUPPORT_DETECT_3RD_PIN:0", "/fragment@42/__overlay__:GPIO_SIM2_HOT_PLUG:0", "/fragment@42/__overlay__:GPIO_SIM1_HOT_PLUG:0", "/fragment@42/__overlay__:GPIO_FDD_BAND_SUPPORT_DETECT_4TH_PIN:0", "/fragment@42/__overlay__:GPIO_SIM2_SIO:0", "/fragment@42/__overlay__:GPIO_SIM2_SRST:0", "/fragment@42/__overlay__:GPIO_SIM2_SCLK:0", "/fragment@42/__overlay__:GPIO_FDD_BAND_SUPPORT_DETECT_1ST_PIN:0", "/fragment@42/__overlay__:GPIO_SIM1_SCLK:0", "/fragment@42/__overlay__:GPIO_SIM1_SRST:0", "/fragment@42/__overlay__:GPIO_SIM1_SIO:0", "/fragment@44/__overlay__:interrupt-parent:0", "/fragment@45/__overlay__:interrupt-parent:0", "/fragment@46/__overlay__:interrupt-parent:0", "/fragment@47/__overlay__:interrupt-parent:0", "/fragment@48/__overlay__:interrupt-parent:0", "/fragment@49/__overlay__:interrupt-parent:0", "/fragment@50/__overlay__:interrupt-parent:0", "/fragment@51/__overlay__:interrupt-parent:0", "/fragment@51/__overlay__:deb-gpios:0", "/fragment@52/__overlay__:interrupt-parent:0", "/fragment@53/__overlay__:interrupt-parent:0", "/fragment@66:target:0";
		pmic_clock_buffer_ctrl = "/fragment@32:target:0";
		reserved_memory = "/fragment@0:target:0";
		reverse_high = "/fragment@4/__overlay__:pinctrl-0:0";
		reverse_low = "/fragment@4/__overlay__:pinctrl-1:0";
		rt9465_slave_chr = "/fragment@49:target:0";
		smart_pa = "/fragment@52:target:0";
		spi2 = "/fragment@11:target:0";
		spi5 = "/fragment@10:target:0";
		subpmic_pmu_eint = "/fragment@47:target:0";
		swtp = "/fragment@51:target:0";
		tcpc_pd = "/fragment@48:target:0";
		touch = "/fragment@7:target:0", "/fragment@44:target:0", "/fragment@64:target:0";
	};

	__local_fixups__ {

		fragment@12 {

			__overlay__ {
				pinctrl-0 = <0x0>;
				pinctrl-1 = <0x0>;
				pinctrl-2 = <0x0>;
				pinctrl-3 = <0x0>;
				pinctrl-4 = <0x0>;
			};
		};

		fragment@25 {

			__overlay__ {
				pinctrl-0 = <0x0>;
				pinctrl-1 = <0x0>;
				pinctrl-2 = <0x0>;
				pinctrl-3 = <0x0>;
			};
		};

		fragment@26 {

			__overlay__ {
				pinctrl-0 = <0x0>;
				pinctrl-1 = <0x0>;
			};
		};

		fragment@29 {

			__overlay__ {
				pinctrl-0 = <0x0>;
				pinctrl-1 = <0x0>;
				pinctrl-2 = <0x0>;
			};
		};

		fragment@5 {

			__overlay__ {
				pinctrl-0 = <0x0>;
				pinctrl-1 = <0x0>;
				pinctrl-2 = <0x0>;
				pinctrl-3 = <0x0>;
				pinctrl-4 = <0x0>;
			};
		};

		fragment@67 {

			__overlay__ {
				pinctrl-0 = <0x0>;
				pinctrl-1 = <0x0>;
				pinctrl-10 = <0x0>;
				pinctrl-11 = <0x0>;
				pinctrl-12 = <0x0>;
				pinctrl-13 = <0x0>;
				pinctrl-14 = <0x0>;
				pinctrl-15 = <0x0>;
				pinctrl-16 = <0x0>;
				pinctrl-17 = <0x0>;
				pinctrl-18 = <0x0>;
				pinctrl-19 = <0x0>;
				pinctrl-2 = <0x0>;
				pinctrl-20 = <0x0>;
				pinctrl-21 = <0x0>;
				pinctrl-22 = <0x0>;
				pinctrl-23 = <0x0>;
				pinctrl-24 = <0x0>;
				pinctrl-25 = <0x0>;
				pinctrl-26 = <0x0>;
				pinctrl-27 = <0x0>;
				pinctrl-28 = <0x0>;
				pinctrl-29 = <0x0>;
				pinctrl-3 = <0x0>;
				pinctrl-30 = <0x0>;
				pinctrl-31 = <0x0>;
				pinctrl-32 = <0x0>;
				pinctrl-33 = <0x0>;
				pinctrl-34 = <0x0>;
				pinctrl-35 = <0x0>;
				pinctrl-36 = <0x0>;
				pinctrl-37 = <0x0>;
				pinctrl-38 = <0x0>;
				pinctrl-39 = <0x0>;
				pinctrl-4 = <0x0>;
				pinctrl-40 = <0x0>;
				pinctrl-41 = <0x0>;
				pinctrl-42 = <0x0>;
				pinctrl-43 = <0x0>;
				pinctrl-44 = <0x0>;
				pinctrl-45 = <0x0>;
				pinctrl-46 = <0x0>;
				pinctrl-47 = <0x0>;
				pinctrl-48 = <0x0>;
				pinctrl-49 = <0x0>;
				pinctrl-5 = <0x0>;
				pinctrl-6 = <0x0>;
				pinctrl-7 = <0x0>;
				pinctrl-8 = <0x0>;
				pinctrl-9 = <0x0>;
			};
		};

		fragment@7 {

			__overlay__ {
				pinctrl-0 = <0x0>;
				pinctrl-1 = <0x0>;
				pinctrl-2 = <0x0>;
				pinctrl-3 = <0x0>;
				pinctrl-4 = <0x0>;
				pinctrl-5 = <0x0>;
			};
		};
	};

	__symbols__ {
		camera0_mclk_2mA = "/fragment@66/__overlay__/camera0_mclk_2mA@gpio100";
		camera0_mclk_4mA = "/fragment@66/__overlay__/camera0_mclk_4mA@gpio100";
		camera0_mclk_6mA = "/fragment@66/__overlay__/camera0_mclk_6mA@gpio100";
		camera0_mclk_8mA = "/fragment@66/__overlay__/camera0_mclk_8mA@gpio100";
		camera0_mclk_off = "/fragment@66/__overlay__/camera0_mclk_gpio_mode@gpio100";
		camera0_rst_high = "/fragment@66/__overlay__/camera0_rst_output_high@gpio102";
		camera0_rst_low = "/fragment@66/__overlay__/camera0_rst_output_low@gpio102";
		camera0_vcama_off = "/fragment@66/__overlay__/camera0_vcama_output_low@gpio24";
		camera0_vcama_on = "/fragment@66/__overlay__/camera0_vcama_output_high@gpio24";
		camera1_cam_mipi_switch_en_0 = "/fragment@66/__overlay__/camera1_mipi_switch_output_low@gpio3";
		camera1_cam_mipi_switch_en_1 = "/fragment@66/__overlay__/camera1_mipi_switch_output_high@gpio3";
		camera1_cam_mipi_switch_sel_0 = "/fragment@66/__overlay__/camera1_mipi_switch_output_low@gpio4";
		camera1_cam_mipi_switch_sel_1 = "/fragment@66/__overlay__/camera1_mipi_switch_output_high@gpio4";
		camera1_mclk_2mA = "/fragment@66/__overlay__/camera1_mclk_2mA@gpio108";
		camera1_mclk_4mA = "/fragment@66/__overlay__/camera1_mclk_4mA@gpio108";
		camera1_mclk_6mA = "/fragment@66/__overlay__/camera1_mclk_6mA@gpio108";
		camera1_mclk_8mA = "/fragment@66/__overlay__/camera1_mclk_8mA@gpio108";
		camera1_mclk_off = "/fragment@66/__overlay__/camera1_mclk_gpio_mode@gpio108";
		camera1_rst_high = "/fragment@66/__overlay__/camera1_rst_output_high@gpio109";
		camera1_rst_low = "/fragment@66/__overlay__/camera1_rst_output_low@gpio109";
		camera1_vcama_off = "/fragment@66/__overlay__/camera1_vcama_output_low@gpio24";
		camera1_vcama_on = "/fragment@66/__overlay__/camera1_vcama_output_high@gpio24";
		camera2_mclk_2mA = "/fragment@66/__overlay__/camera2_mclk_2mA@gpio108";
		camera2_mclk_4mA = "/fragment@66/__overlay__/camera2_mclk_4mA@gpio108";
		camera2_mclk_6mA = "/fragment@66/__overlay__/camera2_mclk_6mA@gpio108";
		camera2_mclk_8mA = "/fragment@66/__overlay__/camera2_mclk_8mA@gpio108";
		camera2_mclk_off = "/fragment@66/__overlay__/camera2_mclk_gpio_mode@gpio108";
		camera2_rst_high = "/fragment@66/__overlay__/camera2_rst_output_high@gpio7";
		camera2_rst_low = "/fragment@66/__overlay__/camera2_rst_output_low@gpio7";
		camera3_mclk_2mA = "/fragment@66/__overlay__/camera3_mclk_2mA@gpio99";
		camera3_mclk_4mA = "/fragment@66/__overlay__/camera3_mclk_4mA@gpio99";
		camera3_mclk_6mA = "/fragment@66/__overlay__/camera3_mclk_6mA@gpio99";
		camera3_mclk_8mA = "/fragment@66/__overlay__/camera3_mclk_8mA@gpio99";
		camera3_mclk_off = "/fragment@66/__overlay__/camera3_mclk_gpio_mode@gpio99";
		camera3_rst_high = "/fragment@66/__overlay__/camera3_rst_output_high@gpio101";
		camera3_rst_low = "/fragment@66/__overlay__/camera3_rst_output_low@gpio101";
		camera3_vcamd_off = "/fragment@66/__overlay__/camera3_vcamd_output_low@gpio0";
		camera3_vcamd_on = "/fragment@66/__overlay__/camera3_vcamd_output_high@gpio0";
		camera4_id_high = "/fragment@66/__overlay__/camera4_id_input_high@gpio79";
		camera4_id_low = "/fragment@66/__overlay__/camera4_id_input_low@gpio79";
		camera4_mclk_2mA = "/fragment@66/__overlay__/camera4_mclk_2mA@gpio111";
		camera4_mclk_4mA = "/fragment@66/__overlay__/camera4_mclk_4mA@gpio111";
		camera4_mclk_6mA = "/fragment@66/__overlay__/camera4_mclk_6mA@gpio111";
		camera4_mclk_8mA = "/fragment@66/__overlay__/camera4_mclk_8mA@gpio111";
		camera4_mclk_off = "/fragment@66/__overlay__/camera4_mclk_gpio_mode@gpio111";
		camera4_rst_high = "/fragment@66/__overlay__/camera4_rst_output_high@gpio112";
		camera4_rst_low = "/fragment@66/__overlay__/camera4_rst_output_low@gpio112";
		camera_main_af_mtk = "/fragment@37/__overlay__/camera_main_af@0c";
		camera_main_eeprom_mtk = "/fragment@37/__overlay__/camera_main_eeprom@50";
		camera_main_mtk = "/fragment@37/__overlay__/camera_main@20";
		camera_main_three_af_mtk = "/fragment@37/__overlay__/camera_main_three_af@18";
		camera_main_three_eeprom_mtk = "/fragment@37/__overlay__/camera_main_three_eeprom@53";
		camera_main_three_mtk = "/fragment@37/__overlay__/camera_main_three@5b";
		camera_main_two_eeprom_mtk = "/fragment@35/__overlay__/camera_main_two_eeprom@51";
		camera_main_two_mtk = "/fragment@35/__overlay__/camera_main_two@5a";
		camera_pins_default = "/fragment@66/__overlay__/camdefault";
		camera_sub_eeprom_mtk = "/fragment@35/__overlay__/camera_sub_eeprom@52";
		camera_sub_mtk = "/fragment@35/__overlay__/camera_sub@6c";
		camera_sub_two_mtk = "/fragment@37/__overlay__/camera_sub_two@6b";
		cap_touch_mtk = "/fragment@33/__overlay__/cap_touch@14";
		consys_pins_default = "/fragment@24/__overlay__/consys_default";
		ctp_pins_default = "/fragment@8/__overlay__/eint0default";
		ctp_pins_eint_as_int = "/fragment@8/__overlay__/eint@0";
		ctp_pins_eint_output0 = "/fragment@8/__overlay__/eintoutput0";
		ctp_pins_eint_output1 = "/fragment@8/__overlay__/eintoutput1";
		ctp_pins_rst_output0 = "/fragment@8/__overlay__/rstoutput0";
		ctp_pins_rst_output1 = "/fragment@8/__overlay__/rstoutput1";
		ctp_ts_int_active = "/fragment@13/__overlay__/int_active";
		ctp_ts_int_suspend = "/fragment@13/__overlay__/int_suspend";
		ctp_ts_pins_default = "/fragment@8/__overlay__/eint1default";
		ctp_ts_reset_active = "/fragment@13/__overlay__/reset_active";
		ctp_ts_reset_suspend = "/fragment@13/__overlay__/reset_suspend";
		fingerprint_default = "/fragment@13/__overlay__/state_default";
		fingerprint_reset_high = "/fragment@13/__overlay__/state_reset_high";
		fingerprint_reset_low = "/fragment@13/__overlay__/state_reset_low";
		fingerprint_spi_cs_high = "/fragment@13/__overlay__/state_spi_cs_high";
		fingerprint_spi_cs_low = "/fragment@13/__overlay__/state_spi_cs_low";
		flashlight_pins_default = "/fragment@6/__overlay__/flashlightdefault";
		flashlight_pins_en_output0 = "/fragment@6/__overlay__/flashlightenoutput0";
		flashlight_pins_en_output1 = "/fragment@6/__overlay__/flashlightenoutput1";
		flashlight_pins_sel_output0 = "/fragment@6/__overlay__/flashlightseloutput0";
		flashlight_pins_sel_output1 = "/fragment@6/__overlay__/flashlightseloutput1";
		gpslna_pins_init = "/fragment@24/__overlay__/gpslna@0";
		gpslna_pins_oh = "/fragment@24/__overlay__/gpslna@1";
		gpslna_pins_ol = "/fragment@24/__overlay__/gpslna@2";
		irtx_gpio_led_default = "/fragment@27/__overlay__/irtx_gpio_led_def@gpio12";
		irtx_gpio_led_set = "/fragment@27/__overlay__/irtx_gpio_led_set@gpio12";
		led0 = "/fragment@2/__overlay__/led@0";
		led1 = "/fragment@2/__overlay__/led@1";
		led2 = "/fragment@2/__overlay__/led@2";
		led3 = "/fragment@2/__overlay__/led@3";
		led4 = "/fragment@2/__overlay__/led@4";
		led5 = "/fragment@2/__overlay__/led@5";
		led6 = "/fragment@2/__overlay__/led@6";
		mtkfb_pins_lcm_dsi_te = "/fragment@28/__overlay__/lcm_dsi_te";
		mtkfb_pins_lcm_rst_out0_gpio = "/fragment@28/__overlay__/lcm_rst_out0_gpio";
		mtkfb_pins_lcm_rst_out1_gpio = "/fragment@28/__overlay__/lcm_rst_out1_gpio";
		nfc_mtk = "/fragment@36/__overlay__/nfc@08";
		smb1351_charger_mtk = "/fragment@40/__overlay__/smb1351_charger@55";
		speaker_amp_mtk = "/fragment@40/__overlay__/speaker_amp@34";
		subpmic_pmu_mtk = "/fragment@38/__overlay__/subpmic_pmu@34";
		usb_type_c_mtk = "/fragment@40/__overlay__/usb_type_c@60";
		vibrator0 = "/fragment@2/__overlay__/vibrator@0";
	};

	fragment@0 {
		target = <0xffffffff>;

		__overlay__ {

			reserve-memory-scp_share {
				alignment = <0x0 0x1000000>;
				alloc-ranges = <0x0 0x40000000 0x0 0x50000000>;
				compatible = "mediatek,reserve-memory-scp_share";
				no-map;
				size = <0x0 0xd00000>;
			};
		};
	};

	fragment@1 {
		target = <0xffffffff>;

		__overlay__ {
			atag,videolfb-fb_base_h = <0x0>;
			atag,videolfb-fb_base_l = "~`P";
			atag,videolfb-fps = <0x1770>;
			atag,videolfb-islcm_inited = <0x0>;
			atag,videolfb-islcmfound = <0x1>;
			atag,videolfb-lcmname = "hx83112b_fhdp_dsi_cmd_auo_rt5081_drv";
			atag,videolfb-vramSize = <0x17e8000>;
		};
	};

	fragment@10 {
		target = <0xffffffff>;

		__overlay__ {
			#address-cells = <0x1>;
			#size-cells = <0x0>;

			p61@31 {
				compatible = "nxp,p61";
				reg = <0x0>;
				spi-max-frequency = <0x7a1200>;
				status = "okay";
			};
		};
	};

	fragment@11 {
		target = <0xffffffff>;

		__overlay__ {
			#address-cells = <0x1>;
			#size-cells = <0x0>;
			status = "ok";

			fpc_tee@0 {
				compatible = "goodix,goodix-fp";
				fpc,enable-wakeup;
				netlink-event = <0x1e>;
				reg = <0x0>;
				spi-max-frequency = <0x989680>;
				status = "okay";
			};
		};
	};

	fragment@12 {
		target = <0xffffffff>;

		__overlay__ {
			fpc,gpio_irq = <0xffffffff 0x8 0x0>;
			pinctrl-0 = <0xc>;
			pinctrl-1 = <0xd>;
			pinctrl-2 = <0xe>;
			pinctrl-3 = <0xf>;
			pinctrl-4 = <0x10>;
			pinctrl-names = "default", "reset_high", "reset_low", "spi_cs_low", "spi_cs_high";
			status = "okay";
		};
	};

	fragment@13 {
		target = <0xffffffff>;

		__overlay__ {

			int_active {
				phandle = <0x53>;

				pins_cmd_dat {
					bias-pull-up = <0xb>;
					pinmux = <0x100>;
					slew-rate = <0x0>;
				};
			};

			int_suspend {
				phandle = <0x55>;

				pins_cmd_dat {
					output-low;
					pinmux = <0x100>;
					slew-rate = <0x1>;
				};
			};

			reset_active {
				phandle = <0x54>;

				pins_cmd_dat {
					output-high;
					pinmux = <0x1700>;
					slew-rate = <0x1>;
				};
			};

			reset_suspend {
				phandle = <0x56>;

				pins_cmd_dat {
					output-low;
					pinmux = <0x1700>;
					slew-rate = <0x1>;
				};
			};

			state_default {
				phandle = <0xc>;

				pins_cmd_dat {
					bias-disable;
					pinmux = <0x806>;
					slew-rate = <0x0>;
				};
			};

			state_reset_high {
				phandle = <0xd>;

				pins_cmd_dat {
					output-high;
					pinmux = <0x1f00>;
					slew-rate = <0x1>;
				};
			};

			state_reset_low {
				phandle = <0xe>;

				pins_cmd_dat {
					output-low;
					pinmux = <0x1f00>;
					slew-rate = <0x1>;
				};
			};

			state_spi_cs_high {
				phandle = <0x10>;

				pins_cmd_dat {
					output-high;
					pinmux = <0x1902>;
					slew-rate = <0x1>;
				};
			};

			state_spi_cs_low {
				phandle = <0xf>;

				pins_cmd_dat {
					output-low;
					pinmux = <0x1902>;
					slew-rate = <0x1>;
				};
			};
		};
	};

	fragment@14 {
		target = <0xffffffff>;

		__overlay__ {

			aw87519@58 {
				compatible = "awinic,aw87519_pa";
				reg = <0x58>;
				reset-gpio = <0xffffffff 0x16 0x0>;
				status = "okay";
			};
		};
	};

	fragment@15 {
		target = <0xffffffff>;

		__overlay__ {

			fusb303@21 {
				compatible = "on,fusb303";
				fusb303,autosink-threshold = <0x1>;
				fusb303,cc-debounce-time = <0x3>;
				fusb303,drp-duty-time = <0x0>;
				fusb303,drp-toggle-time = <0x1>;
				fusb303,host-current = <0x2>;
				fusb303,init-mode = <0x14>;
				fusb303,int-gpio = <0xffffffff 0x29 0x0>;
				interrupt-parent = <0xffffffff>;
				interrupts = <0x29 0x2>;
				reg = <0x21>;
				status = "ok";
			};
		};
	};

	fragment@16 {
		target = <0xffffffff>;

		__overlay__ {

			smb1351-charger@55 {
				charger_name = "primary_chg";
				compatible = "qcom,smb1351_charger";
				cv = <0x4313e0>;
				en_st;
				en_wdt;
				ichg = <0x1b7740>;
				ieoc = <0x30d40>;
				interrupt-parent = <0xffffffff>;
				interrupts = <0x14 0x2 0x14 0x0>;
				mivr = <0x44aa20>;
				qcom,bc12_supported;
				qcom,recharge-disabled;
				reg = <0x55>;
				safety_timer = <0xc>;
			};
		};
	};

	fragment@17 {
		target = <0xffffffff>;

		__overlay__ {
			ac_charger_current = <0xf4240>;
			non_std_ac_charger_current = <0xf4240>;
			temp_t1_threshold = <0x0>;
			temp_t3_threshold = <0x2d>;
			temp_t4_threshold = <0x37>;
		};
	};

	fragment@18 {
		target = <0xffffffff>;

		__overlay__ {
			ac_charger_current = <0x1f47d0>;
			ac_charger_input_current = <0x1f47d0>;
			algorithm_name = "SwitchCharging";
			apple_1_0a_charger_current = <0x9eb10>;
			apple_2_1a_charger_current = <0xc3500>;
			battery_cv = <0x440de0>;
			charging_host_charger_current = <0x16e360>;
			enable_min_charge_temp;
			enable_sw_jeita;
			hvdcp_charger_current = <0x2dc6c0>;
			jeita_temp_above_t4_cv = <0x3e8fa0>;
			jeita_temp_below_t0_cv = <0x440de0>;
			jeita_temp_t0_to_t1_cc = <0xf4240>;
			jeita_temp_t0_to_t1_cv = <0x440de0>;
			jeita_temp_t1_to_t2_cc = <0x249f00>;
			jeita_temp_t1_to_t2_cv = <0x440de0>;
			jeita_temp_t2_to_t3_cc = <0x2dc6c0>;
			jeita_temp_t2_to_t3_cv = <0x440de0>;
			jeita_temp_t3_to_t4_cc = <0x249f00>;
			jeita_temp_t3_to_t4_cv = <0x3e8fa0>;
			max_charge_temp = <0x37>;
			max_charge_temp_minus_x_degree = <0x35>;
			min_charge_temp = <0x0>;
			min_charge_temp_plus_x_degree = <0x2>;
			non_std_ac_charger_current = <0xf4240>;
			pd_vbus_upper_bound = <0x895440>;
			qcom,thermal-mitigation-dcp = <0x1b7740 0x1b7740 0x1b7740 0x1b7740 0x1b7740 0x1b7740 0x1b7740 0x1b7740 0x1b7740 0x1b7740 0x1b7740 0x1b7740 0x186a00 0x155cc0 0x124f80 0xf4240>;
			qcom,thermal-mitigation-pd-base = <0x2dc6c0 0x2ab980 0x27ac40 0x249f00 0x2191c0 0x1e8480 0x1b7740 0x186a00 0x186a00 0x155cc0 0x124f80 0x10c8e0 0xf4240 0xdbba0 0xb7b74 0x802c8>;
			qcom,thermal-mitigation-qc2 = <0x18cba8 0x18cba8 0x18cba8 0x18cba8 0x18cba8 0x174508 0x15be68 0x1437c8 0x12b128 0x112a88 0xfa5dc 0xe1d48 0xc96a8 0xb1008 0x98968 0x802c8>;
			qcom,thermal-mitigation-qc3 = <0x2932e0 0x273710 0x249f00 0x22a330 0x205940 0x1dfbc8 0x1bc560 0x192d50 0x16e360 0x14fb18 0x12b128 0x10c8e0 0xee098 0xc96a8 0xa4cb8 0x73f78>;
			set_cap_delay = <0xa>;
			ta_ac_charger_current = <0x1f47d0>;
			temp_neg_10_thres = <0x0>;
			temp_t0_thres = <0x0>;
			temp_t0_thres_plus_x_degree = <0x0>;
			temp_t1_thres = <0x5>;
			temp_t1_thres_plus_x_degree = <0x4>;
			temp_t2_thres = <0xf>;
			temp_t2_thres_plus_x_degree = <0xd>;
			temp_t3_thres = <0x2d>;
			temp_t3_thres_minus_x_degree = <0x2b>;
			temp_t4_thres = <0x37>;
			temp_t4_thres_minus_x_degree = <0x35>;
			usb_charger_current = <0x7a120>;
			usb_charger_current_configured = <0x7a120>;
			usb_charger_current_suspend = <0x0>;
			usb_charger_current_unconfigured = <0x11170>;
		};
	};

	fragment@19 {
		target = <0xffffffff>;

		__overlay__ {
			clock-frequency = <0x61a80>;

			mtk-usb@60 {
				compatible = "mediatek,mtk-usb";
				reg = <0x60>;
				status = "okay";
			};
		};
	};

	fragment@2 {
		target = <0xffffffff>;

		__overlay__ {

			led@0 {
				compatible = "mediatek,red";
				data = <0x1>;
				led_mode = <0x0>;
				phandle = <0x4a>;
				pwm_config = <0x0 0x0 0x0 0x0 0x0>;
			};

			led@1 {
				compatible = "mediatek,green";
				data = <0x1>;
				led_mode = <0x0>;
				phandle = <0x4b>;
				pwm_config = <0x0 0x0 0x0 0x0 0x0>;
			};

			led@2 {
				compatible = "mediatek,blue";
				data = <0x1>;
				led_mode = <0x0>;
				phandle = <0x4c>;
				pwm_config = <0x0 0x0 0x0 0x0 0x0>;
			};

			led@3 {
				compatible = "mediatek,jogball-backlight";
				data = <0x1>;
				led_mode = <0x0>;
				phandle = <0x4d>;
				pwm_config = <0x0 0x0 0x0 0x0 0x0>;
			};

			led@4 {
				compatible = "mediatek,keyboard-backlight";
				data = <0x1>;
				led_mode = <0x0>;
				phandle = <0x4e>;
				pwm_config = <0x0 0x0 0x0 0x0 0x0>;
			};

			led@5 {
				compatible = "mediatek,button-backlight";
				data = <0x1>;
				led_mode = <0x0>;
				phandle = <0x4f>;
				pwm_config = <0x0 0x0 0x0 0x0 0x0>;
			};

			led@6 {
				compatible = "mediatek,lcd-backlight";
				data = <0x1>;
				led_mode = <0x4>;
				phandle = <0x50>;
				pwm_config = <0x0 0x3 0x0 0x0 0x0>;
			};

			vibrator@0 {
				compatible = "mediatek,vibrator";
				phandle = <0x51>;
				vib_limit = <0x9>;
				vib_timer = <0x19>;
				vib_vol = <0xb>;
			};
		};
	};

	fragment@20 {
		target = <0xffffffff>;

		__overlay__ {

			ktd@37 {
				compatible = "ktd,ktd3137";
				ktd,bl-channel = <0x2>;
				ktd,bl-fscal-led = <0x98>;
				ktd,i2c-trans-dim = <0x0>;
				ktd,inductor-current = <0xa28>;
				ktd,linear_backlight = <0x1>;
				ktd,linear_ramp = <0x1>;
				ktd,ovp-level = <0x20>;
				ktd,pwm-frequency = <0x64>;
				ktd,pwm-trans-dim = <0x0>;
				ktd,switching-frequency = <0x3e8>;
				ktd,turn-off-ramp = <0x0>;
				ktd,turn-on-ramp = <0x0>;
				ktd,using-lsb = <0x1>;
				reg = <0x37>;
				status = "okay";
			};

			lcd_bias@3e {
				compatible = "mediatek,lcd_bias";
				reg = <0x3e>;
				status = "okay";
			};

			lm3697@36 {
				compatible = "ti,lm3697";
				enable-gpios = <0xffffffff 0xa0 0x0>;
				reg = <0x36>;
				status = "okay";

				backlight {
					compatible = "ti,lm3697-backlight";

					lcd {
						default-brightness-level = <0xff>;
						led-sources = <0x0 0x1 0x2>;
						pwm-period = <0x0>;
						ramp-down-msec = <0xc8>;
						ramp-up-msec = <0xc8>;
					};
				};

				fault-monitor {
					compatible = "ti,lm3697-fault-monitor";
				};
			};
		};
	};

	fragment@21 {
		target = <0xffffffff>;

		__overlay__ {
			accdet-mic-mode = <0x1>;
			accdet-mic-vol = <0x6>;
			accdet-plugout-debounce = <0x1>;
			headset-eint-level-pol = <0x8>;
			headset-four-key-threshold = <0x0 0x3a 0x79 0xc0 0x190>;
			headset-mode-setting = <0x500 0x500 0x1 0x1f0 0x800 0x800 0x20 0x44>;
			headset-three-key-threshold = <0x0 0x50 0xdc 0x190>;
			headset-three-key-threshold-CDD = <0x0 0x79 0xc0 0x258>;
			status = "okay";
		};
	};

	fragment@22 {
		target = <0xffffffff>;

		__overlay__ {
			mt6370,intr_gpio = <0xffffffff 0x14 0x0>;
			mt6370,intr_gpio_num = <0x14>;
		};
	};

	fragment@23 {
		target = <0xffffffff>;

		__overlay__ {
			mt6370pd,intr_gpio = <0xffffffff 0x29 0x0>;
			mt6370pd,intr_gpio_num = <0x29>;
			mt6370pd,usb_switch_gpio = <0xffffffff 0x5b 0x0>;
			mt6370pd,usb_switch_gpio_num = <0x5b>;
		};
	};

	fragment@24 {
		target = <0xffffffff>;

		__overlay__ {

			consys_default {
				phandle = <0x11>;
			};

			gpslna@0 {
				phandle = <0x12>;

				pins_cmd_dat {
					bias-disable;
					output-low;
					pinmux = <0x5e00>;
					slew-rate = <0x0>;
				};
			};

			gpslna@1 {
				phandle = <0x13>;

				pins_cmd_dat {
					output-high;
					pinmux = <0x5e00>;
					slew-rate = <0x1>;
				};
			};

			gpslna@2 {
				phandle = <0x14>;

				pins_cmd_dat {
					output-low;
					pinmux = <0x5e00>;
					slew-rate = <0x1>;
				};
			};
		};
	};

	fragment@25 {
		target = <0xffffffff>;

		__overlay__ {
			pinctrl-0 = <0x11>;
			pinctrl-1 = <0x12>;
			pinctrl-2 = <0x13>;
			pinctrl-3 = <0x14>;
			pinctrl-names = "default", "gps_lna_state_init", "gps_lna_state_oh", "gps_lna_state_ol";
			status = "okay";
		};
	};

	fragment@26 {
		target = <0xffffffff>;

		__overlay__ {
			pinctrl-0 = <0x15>;
			pinctrl-1 = <0x16>;
			pinctrl-names = "irtx_gpio_led_default", "irtx_gpio_led_set";
			status = "okay";
		};
	};

	fragment@27 {
		target = <0xffffffff>;

		__overlay__ {

			irtx_gpio_led_def@gpio12 {
				phandle = <0x15>;

				pins_cmd_dat {
					bias-disable;
					input-schmitt-enable = <0x0>;
					output-low;
					pinmux = <0xc00>;
					slew-rate = <0x1>;
				};
			};

			irtx_gpio_led_set@gpio12 {
				phandle = <0x16>;

				pins_cmd_dat {
					output-high;
					pinmux = <0xc01>;
					slew-rate = <0x1>;
				};
			};
		};
	};

	fragment@28 {
		target = <0xffffffff>;

		__overlay__ {

			lcm_dsi_te {
				phandle = <0x19>;

				pins_cmd_dat {
					pinmux = <0x2c01>;
				};
			};

			lcm_rst_out0_gpio {
				phandle = <0x18>;

				pins_cmd_dat {
					output-low;
					pinmux = <0x2d00>;
					slew-rate = <0x1>;
				};
			};

			lcm_rst_out1_gpio {
				phandle = <0x17>;

				pins_cmd_dat {
					output-high;
					pinmux = <0x2d00>;
					slew-rate = <0x1>;
				};
			};
		};
	};

	fragment@29 {
		target = <0xffffffff>;

		__overlay__ {
			pinctrl-0 = <0x17>;
			pinctrl-1 = <0x18>;
			pinctrl-2 = <0x19>;
			pinctrl-names = "lcm_rst_out1_gpio", "lcm_rst_out0_gpio", "mode_te_te";
			status = "okay";
		};
	};

	fragment@3 {
		target = <0xffffffff>;

		__overlay__ {
			board_id2-gpios = <0xffffffff 0x5 0x0>;
			board_id3-gpios = <0xffffffff 0x6 0x0>;
			hw_id-gpios = <0xffffffff 0x9e 0x0>;
			io-channel-names = "board_id-channel";
			io-channels = <0xffffffff 0x3>;
			status = "okay";
		};
	};

	fragment@30 {
		target = <0xffffffff>;

		__overlay__ {

			adc_channel@ {
				compatible = "mediatek,adc_channel";
				mediatek,adc_fdd_rf_params_dynamic_custom_ch = <0x2>;
				mediatek,temperature0 = <0x0>;
				mediatek,temperature1 = <0x1>;
				status = "okay";
			};
		};
	};

	fragment@31 {
		target = <0xffffffff>;

		__overlay__ {
			io-channels = <0xffffffff 0x2>;
		};
	};

	fragment@32 {
		target = <0xffffffff>;

		__overlay__ {
			mediatek,clkbuf-config = <0x2 0x1 0x1 0x2 0x0 0x0 0x0>;
			mediatek,clkbuf-driving-current = <0x1 0x1 0x1 0x1 0x1 0x1 0x1>;
			mediatek,clkbuf-quantity = <0x7>;
			status = "okay";
		};
	};

	fragment@33 {
		target = <0xffffffff>;

		__overlay__ {
			#address-cells = <0x1>;
			#size-cells = <0x0>;
			clock-frequency = <0x61a80>;
			mediatek,use-open-drain;

			cap_touch@14 {
				compatible = "mediatek,cap_touch";
				phandle = <0x57>;
				reg = <0x14>;
				status = "okay";
			};
		};
	};

	fragment@34 {
		target = <0xffffffff>;

		__overlay__ {
			#address-cells = <0x1>;
			#size-cells = <0x0>;
			clock-frequency = <0x61a80>;
			mediatek,use-open-drain;
		};
	};

	fragment@35 {
		target = <0xffffffff>;

		__overlay__ {
			#address-cells = <0x1>;
			#size-cells = <0x0>;
			clock-frequency = <0x61a80>;
			mediatek,use-open-drain;

			camera_main_two@5a {
				compatible = "mediatek,camera_main_two";
				phandle = <0x58>;
				reg = <0x5a>;
				status = "okay";
			};

			camera_main_two_eeprom@51 {
				compatible = "mediatek,camera_main_two_eeprom";
				phandle = <0x5b>;
				reg = <0x51>;
				status = "okay";
			};

			camera_sub@6c {
				compatible = "mediatek,camera_sub";
				phandle = <0x59>;
				reg = <0x6c>;
				status = "okay";
			};

			camera_sub_eeprom@52 {
				compatible = "mediatek,camera_sub_eeprom";
				phandle = <0x5a>;
				reg = <0x52>;
				status = "okay";
			};
		};
	};

	fragment@36 {
		target = <0xffffffff>;

		__overlay__ {
			#address-cells = <0x1>;
			#size-cells = <0x0>;
			clock-frequency = <0x61a80>;
			mediatek,use-open-drain;

			nfc@08 {
				compatible = "mediatek,nfc";
				phandle = <0x5c>;
				reg = <0x8>;
				status = "okay";
			};
		};
	};

	fragment@37 {
		target = <0xffffffff>;

		__overlay__ {
			#address-cells = <0x1>;
			#size-cells = <0x0>;
			clock-frequency = <0x61a80>;
			mediatek,use-open-drain;

			camera_main@20 {
				compatible = "mediatek,camera_main";
				phandle = <0x5e>;
				reg = <0x20>;
				status = "okay";
			};

			camera_main_af@0c {
				compatible = "mediatek,camera_main_af";
				phandle = <0x60>;
				reg = <0xc>;
				status = "okay";
			};

			camera_main_eeprom@50 {
				compatible = "mediatek,camera_main_eeprom";
				phandle = <0x5f>;
				reg = <0x50>;
				status = "okay";
			};

			camera_main_three@5b {
				compatible = "mediatek,camera_main_three";
				phandle = <0x5d>;
				reg = <0x5b>;
				status = "okay";
			};

			camera_main_three_af@18 {
				compatible = "mediatek,camera_main_three_af";
				phandle = <0x62>;
				reg = <0x18>;
				status = "okay";
			};

			camera_main_three_eeprom@53 {
				compatible = "mediatek,camera_main_three_eeprom";
				phandle = <0x63>;
				reg = <0x53>;
				status = "okay";
			};

			camera_sub_two@6b {
				compatible = "mediatek,camera_sub_two";
				phandle = <0x61>;
				reg = <0x6b>;
				status = "okay";
			};
		};
	};

	fragment@38 {
		target = <0xffffffff>;

		__overlay__ {
			#address-cells = <0x1>;
			#size-cells = <0x0>;
			clock-frequency = <0x33e140>;
			mediatek,use-push-pull;

			subpmic_pmu@34 {
				compatible = "mediatek,subpmic_pmu";
				phandle = <0x64>;
				reg = <0x34>;
				status = "okay";
			};
		};
	};

	fragment@39 {
		target = <0xffffffff>;

		__overlay__ {
			#address-cells = <0x1>;
			#size-cells = <0x0>;
			clock-frequency = <0x61a80>;
			mediatek,use-open-drain;
		};
	};

	fragment@4 {
		target = <0xffffffff>;

		__overlay__ {
			interrupt-parent = <0xffffffff>;
			pinctrl-0 = <0xffffffff>;
			pinctrl-1 = <0xffffffff>;
			pinctrl-names = "reverse_high", "reverse_low";
			reverse-gpio = <0xffffffff 0x5b 0x0>;
		};
	};

	fragment@40 {
		target = <0xffffffff>;

		__overlay__ {
			#address-cells = <0x1>;
			#size-cells = <0x0>;
			clock-frequency = <0x61a80>;
			mediatek,use-open-drain;

			smb1351_charger@55 {
				compatible = "mediatek,smb1351_charger";
				phandle = <0x67>;
				reg = <0x55>;
				status = "okay";
			};

			speaker_amp@34 {
				compatible = "mediatek,speaker_amp";
				phandle = <0x66>;
				reg = <0x34>;
				status = "okay";
			};

			usb_type_c@60 {
				compatible = "mediatek,usb_type_c";
				phandle = <0x65>;
				reg = <0x60>;
				status = "okay";
			};
		};
	};

	fragment@41 {
		target = <0xffffffff>;

		__overlay__ {
			#address-cells = <0x1>;
			#size-cells = <0x0>;
			clock-frequency = <0x61a80>;
			mediatek,use-open-drain;
		};
	};

	fragment@42 {
		target = <0xffffffff>;

		__overlay__ {
			GPIO_FDD_BAND_SUPPORT_DETECT_1ST_PIN = <0xffffffff 0x9e 0x0>;
			GPIO_FDD_BAND_SUPPORT_DETECT_2ND_PIN = <0xffffffff 0x5 0x0>;
			GPIO_FDD_BAND_SUPPORT_DETECT_3RD_PIN = <0xffffffff 0x6 0x0>;
			GPIO_FDD_BAND_SUPPORT_DETECT_4TH_PIN = <0xffffffff 0x5b 0x0>;
			GPIO_SIM1_HOT_PLUG = <0xffffffff 0x2f 0x0>;
			GPIO_SIM1_SCLK = <0xffffffff 0xac 0x0>;
			GPIO_SIM1_SIO = <0xffffffff 0xae 0x0>;
			GPIO_SIM1_SRST = <0xffffffff 0xad 0x0>;
			GPIO_SIM2_HOT_PLUG = <0xffffffff 0x2e 0x0>;
			GPIO_SIM2_SCLK = <0xffffffff 0x9d 0x0>;
			GPIO_SIM2_SIO = <0xffffffff 0x9b 0x0>;
			GPIO_SIM2_SRST = <0xffffffff 0x9c 0x0>;
		};
	};

	fragment@43 {
		target = <0xffffffff>;

		__overlay__ {
			gpio_init_default = <0x0 0x0 0x0 0x0 0x1 0x1 0x1 0x1 0x0 0x0 0x0 0x1 0x1 0x1 0x2 0x0 0x0 0x0 0x1 0x0 0x1 0x3 0x0 0x1 0x0 0x0 0x0 0x1 0x4 0x0 0x1 0x0 0x0 0x0 0x0 0x5 0x0 0x0 0x0 0x0 0x0 0x0 0x6 0x0 0x0 0x0 0x0 0x0 0x0 0x7 0x0 0x1 0x0 0x0 0x0 0x0 0x8 0x0 0x0 0x0 0x1 0x0 0x0 0x9 0x0 0x0 0x0 0x1 0x0 0x1 0xa 0x0 0x0 0x0 0x1 0x0 0x1 0xb 0x1 0x0 0x0 0x1 0x0 0x0 0xc 0x1 0x1 0x0 0x1 0x0 0x0 0xd 0x2 0x0 0x0 0x1 0x0 0x0 0xe 0x2 0x1 0x0 0x0 0x0 0x0 0xf 0x2 0x1 0x0 0x0 0x0 0x0 0x10 0x2 0x1 0x0 0x0 0x0 0x0 0x11 0x0 0x1 0x0 0x0 0x0 0x1 0x12 0x0 0x0 0x0 0x1 0x1 0x1 0x13 0x0 0x0 0x0 0x1 0x1 0x1 0x14 0x0 0x0 0x0 0x1 0x1 0x1 0x15 0x0 0x0 0x0 0x1 0x0 0x0 0x16 0x2 0x1 0x1 0x1 0x0 0x0 0x17 0x0 0x0 0x0 0x1 0x1 0x0 0x18 0x0 0x1 0x0 0x0 0x0 0x0 0x19 0x2 0x1 0x1 0x0 0x0 0x0 0x1a 0x2 0x1 0x0 0x0 0x0 0x0 0x1b 0x2 0x1 0x0 0x0 0x0 0x0 0x1c 0x2 0x0 0x0 0x0 0x0 0x0 0x1d 0x0 0x0 0x0 0x1 0x0 0x0 0x1e 0x0 0x1 0x0 0x0 0x0 0x0 0x1f 0x0 0x1 0x0 0x1 0x0 0x0 0x20 0x1 0x0 0x0 0x0 0x0 0x0 0x21 0x1 0x1 0x1 0x0 0x0 0x0 0x22 0x1 0x1 0x0 0x0 0x0 0x0 0x23 0x1 0x1 0x0 0x0 0x0 0x0 0x24 0x0 0x1 0x1 0x0 0x0 0x0 0x25 0x0 0x1 0x1 0x0 0x0 0x0 0x26 0x0 0x1 0x1 0x0 0x0 0x0 0x27 0x0 0x0 0x0 0x1 0x1 0x1 0x28 0x2 0x0 0x0 0x1 0x0 0x0 0x29 0x0 0x0 0x0 0x1 0x1 0x1 0x2a 0x0 0x0 0x0 0x1 0x1 0x1 0x2b 0x0 0x1 0x1 0x1 0x1 0x0 0x2c 0x1 0x0 0x0 0x1 0x0 0x0 0x2d 0x0 0x1 0x0 0x0 0x0 0x0 0x2e 0x1 0x0 0x0 0x1 0x1 0x0 0x2f 0x1 0x0 0x0 0x1 0x1 0x0 0x30 0x1 0x0 0x0 0x1 0x1 0x1 0x31 0x1 0x0 0x0 0x1 0x1 0x1 0x32 0x1 0x0 0x0 0x1 0x1 0x1 0x33 0x1 0x0 0x0 0x1 0x1 0x1 0x34 0x0 0x0 0x0 0x1 0x0 0x0 0x35 0x1 0x0 0x0 0x1 0x0 0x0 0x36 0x1 0x0 0x0 0x1 0x0 0x0 0x37 0x1 0x0 0x0 0x1 0x0 0x0 0x38 0x0 0x0 0x0 0x0 0x0 0x0 0x39 0x1 0x0 0x0 0x1 0x0 0x0 0x3a 0x0 0x0 0x0 0x1 0x0 0x0 0x3b 0x1 0x0 0x0 0x1 0x0 0x0 0x3c 0x1 0x0 0x0 0x1 0x0 0x0 0x3d 0x1 0x0 0x0 0x1 0x0 0x0 0x3e 0x1 0x0 0x0 0x1 0x0 0x0 0x3f 0x1 0x0 0x0 0x1 0x0 0x0 0x40 0x1 0x0 0x0 0x1 0x0 0x0 0x41 0x1 0x0 0x0 0x1 0x0 0x0 0x42 0x1 0x0 0x0 0x1 0x0 0x0 0x43 0x1 0x0 0x0 0x1 0x0 0x0 0x44 0x1 0x0 0x0 0x1 0x0 0x0 0x45 0x1 0x0 0x0 0x1 0x0 0x0 0x46 0x1 0x0 0x0 0x1 0x0 0x0 0x47 0x1 0x0 0x0 0x1 0x0 0x0 0x48 0x1 0x0 0x0 0x1 0x0 0x0 0x49 0x0 0x1 0x0 0x1 0x0 0x0 0x4a 0x1 0x0 0x0 0x1 0x0 0x0 0x4b 0x1 0x0 0x0 0x1 0x0 0x0 0x4c 0x1 0x0 0x0 0x1 0x0 0x0 0x4d 0x1 0x0 0x0 0x1 0x0 0x0 0x4e 0x1 0x0 0x0 0x1 0x0 0x0 0x4f 0x0 0x0 0x0 0x1 0x0 0x1 0x50 0x0 0x0 0x0 0x1 0x1 0x1 0x51 0x2 0x0 0x0 0x1 0x1 0x1 0x52 0x1 0x0 0x0 0x1 0x1 0x1 0x53 0x1 0x0 0x0 0x1 0x1 0x1 0x54 0x2 0x0 0x0 0x1 0x1 0x1 0x55 0x2 0x0 0x0 0x1 0x0 0x0 0x56 0x2 0x1 0x0 0x0 0x0 0x0 0x57 0x2 0x1 0x0 0x0 0x0 0x0 0x58 0x2 0x1 0x0 0x0 0x0 0x0 0x59 0x1 0x0 0x0 0x1 0x1 0x1 0x5a 0x1 0x0 0x0 0x1 0x1 0x1 0x5b 0x0 0x0 0x0 0x0 0x0 0x0 0x5c 0x0 0x1 0x0 0x1 0x0 0x0 0x5d 0x1 0x0 0x0 0x1 0x1 0x0 0x5e 0x0 0x1 0x0 0x0 0x0 0x0 0x5f 0x1 0x0 0x0 0x1 0x1 0x0 0x60 0x1 0x1 0x0 0x0 0x0 0x0 0x61 0x0 0x1 0x0 0x0 0x0 0x0 0x62 0x0 0x1 0x0 0x0 0x0 0x0 0x63 0x1 0x1 0x0 0x0 0x0 0x0 0x64 0x1 0x1 0x0 0x0 0x0 0x0 0x65 0x0 0x1 0x0 0x0 0x0 0x0 0x66 0x0 0x1 0x0 0x0 0x0 0x0 0x67 0x1 0x0 0x0 0x1 0x1 0x1 0x68 0x1 0x0 0x0 0x1 0x1 0x1 0x69 0x1 0x0 0x0 0x1 0x1 0x1 0x6a 0x1 0x0 0x0 0x1 0x1 0x1 0x6b 0x0 0x1 0x0 0x0 0x0 0x0 0x6c 0x1 0x1 0x0 0x0 0x0 0x0 0x6d 0x0 0x1 0x0 0x0 0x0 0x0 0x6e 0x0 0x1 0x0 0x0 0x0 0x0 0x6f 0x1 0x1 0x0 0x0 0x0 0x0 0x70 0x0 0x1 0x0 0x0 0x0 0x0 0x71 0x0 0x0 0x0 0x1 0x0 0x0 0x72 0x0 0x0 0x0 0x1 0x0 0x0 0x73 0x0 0x0 0x0 0x1 0x0 0x0 0x74 0x0 0x0 0x0 0x1 0x0 0x0 0x75 0x0 0x0 0x0 0x1 0x0 0x0 0x76 0x0 0x0 0x0 0x1 0x0 0x0 0x77 0x0 0x0 0x0 0x1 0x0 0x0 0x78 0x0 0x0 0x0 0x1 0x0 0x0 0x79 0x0 0x0 0x0 0x1 0x0 0x0 0x86 0x1 0x0 0x0 0x1 0x0 0x1 0x87 0x1 0x1 0x0 0x0 0x0 0x0 0x88 0x1 0x1 0x0 0x0 0x0 0x0 0x89 0x1 0x1 0x0 0x0 0x0 0x0 0x8a 0x1 0x1 0x0 0x0 0x0 0x0 0x8b 0x1 0x1 0x0 0x0 0x0 0x0 0x8c 0x1 0x0 0x0 0x1 0x0 0x0 0x8d 0x1 0x0 0x0 0x1 0x0 0x0 0x8e 0x1 0x0 0x0 0x1 0x0 0x0 0x8f 0x1 0x0 0x0 0x1 0x0 0x0 0x90 0x1 0x0 0x0 0x1 0x0 0x0 0x91 0x1 0x1 0x0 0x0 0x0 0x0 0x92 0x1 0x1 0x0 0x0 0x0 0x0 0x93 0x1 0x1 0x0 0x0 0x0 0x0 0x94 0x1 0x1 0x0 0x0 0x0 0x0 0x95 0x1 0x1 0x0 0x0 0x0 0x0 0x96 0x4 0x0 0x0 0x1 0x1 0x0 0x97 0x4 0x1 0x0 0x0 0x0 0x0 0x98 0x0 0x1 0x0 0x1 0x0 0x0 0x99 0x0 0x1 0x0 0x1 0x0 0x0 0x9a 0x1 0x1 0x0 0x0 0x0 0x0 0x9b 0x1 0x0 0x0 0x1 0x1 0x0 0x9c 0x1 0x1 0x0 0x0 0x0 0x0 0x9d 0x1 0x1 0x0 0x0 0x0 0x0 0x9e 0x0 0x0 0x0 0x0 0x0 0x0 0x9f 0x0 0x1 0x0 0x0 0x0 0x0 0xa0 0x0 0x1 0x0 0x0 0x0 0x0 0xa1 0x1 0x0 0x0 0x1 0x1 0x1 0xa2 0x1 0x0 0x0 0x1 0x1 0x1 0xa3 0x1 0x0 0x0 0x1 0x1 0x1 0xa4 0x1 0x0 0x0 0x1 0x1 0x1 0xa5 0x0 0x1 0x0 0x0 0x0 0x0 0xa6 0x0 0x1 0x0 0x0 0x0 0x0 0xa7 0x1 0x0 0x0 0x1 0x0 0x0 0xa8 0x1 0x0 0x0 0x1 0x0 0x0 0xa9 0x0 0x1 0x0 0x0 0x0 0x0 0xaa 0x1 0x0 0x0 0x1 0x1 0x1 0xab 0x1 0x1 0x0 0x0 0x0 0x1 0xac 0x1 0x1 0x0 0x0 0x0 0x0 0xad 0x1 0x1 0x0 0x0 0x0 0x0 0xae 0x1 0x0 0x0 0x1 0x1 0x0 0xaf 0x1 0x0 0x0 0x1 0x1 0x1 0xb0 0x1 0x0 0x0 0x1 0x1 0x1 0xb2 0x0 0x0 0x0 0x1 0x0 0x0 0xb3 0x0 0x1 0x0 0x0 0x0 0x0 0xb4 0x0 0x0 0x0 0x1 0x0 0x0 0xb5 0x0 0x0 0x0 0x1 0x0 0x0 0xb6 0x0 0x0 0x0 0x1 0x0 0x0 0xb7 0x0 0x0 0x0 0x1 0x0 0x0 0xb8 0x0 0x0 0x0 0x1 0x0 0x0 0xb9 0x0 0x0 0x0 0x1 0x0 0x0 0xba 0x0 0x0 0x0 0x1 0x0 0x0>;
		};
	};

	fragment@44 {
		target = <0xffffffff>;

		__overlay__ {
			interrupt-parent = <0xffffffff>;
			interrupts = <0x1 0x2 0x1 0x0>;
			status = "okay";
		};
	};

	fragment@45 {
		target = <0xffffffff>;

		__overlay__ {
			interrupt-parent = <0xffffffff>;
			interrupts = <0x8 0x2 0x8 0x0>;
			status = "okay";
		};
	};

	fragment@46 {
		target = <0xffffffff>;

		__overlay__ {
			interrupt-parent = <0xffffffff>;
			interrupts = <0x9 0x4 0x9 0x0>;
			status = "okay";
		};
	};

	fragment@47 {
		target = <0xffffffff>;

		__overlay__ {
			interrupt-parent = <0xffffffff>;
			interrupts = <0x14 0x2 0x14 0x0>;
			status = "okay";
		};
	};

	fragment@48 {
		target = <0xffffffff>;

		__overlay__ {
			interrupt-parent = <0xffffffff>;
			interrupts = <0x29 0x2 0x29 0x0>;
			status = "okay";
		};
	};

	fragment@49 {
		target = <0xffffffff>;

		__overlay__ {
			interrupt-parent = <0xffffffff>;
			interrupts = <0x2a 0x2 0x2a 0x0>;
			status = "okay";
		};
	};

	fragment@5 {
		target = <0xffffffff>;

		__overlay__ {
			pinctrl-0 = <0x1>;
			pinctrl-1 = <0x2>;
			pinctrl-2 = <0x3>;
			pinctrl-3 = <0x4>;
			pinctrl-4 = <0x5>;
			pinctrl-names = "default", "hw_ch0_high", "hw_ch0_low", "hw_ch1_high", "hw_ch1_low";
			status = "okay";
		};
	};

	fragment@50 {
		target = <0xffffffff>;

		__overlay__ {
			interrupt-parent = <0xffffffff>;
			interrupts = <0x2c 0x1 0x2c 0x1>;
			status = "okay";
		};
	};

	fragment@51 {
		target = <0xffffffff>;

		__overlay__ {
			deb-gpios = <0xffffffff 0x38 0x0>;
			debounce = <0x7d000>;
			interrupt-parent = <0xffffffff>;
			interrupts = <0x38 0x4 0x38 0x0>;
			status = "okay";
		};
	};

	fragment@52 {
		target = <0xffffffff>;

		__overlay__ {
			interrupt-parent = <0xffffffff>;
			interrupts = <0x50 0x2 0x50 0x0>;
			status = "okay";
		};
	};

	fragment@53 {
		target = <0xffffffff>;

		__overlay__ {
			interrupt-parent = <0xffffffff>;
			interrupts = <0x90 0x4 0xb4 0x0>;
			status = "okay";
		};
	};

	fragment@54 {
		target = <0xffffffff>;

		__overlay__ {
			compatible = "mediatek,md1_sim1_hot_plug_eint-eint";
			debounce = <0x0 0x2710>;
			dedicated = <0x0 0x0>;
			interrupts = <0x0 0x8>;
			sockettype = <0x0 0x0>;
			src_pin = <0x0 0x1>;
			status = "okay";
		};
	};

	fragment@55 {
		target = <0xffffffff>;

		__overlay__ {
			compatible = "mediatek,md1_sim2_hot_plug_eint-eint";
			debounce = <0x1 0x2710>;
			dedicated = <0x1 0x0>;
			interrupts = <0x1 0x8>;
			sockettype = <0x1 0x0>;
			src_pin = <0x1 0x2>;
			status = "okay";
		};
	};

	fragment@56 {
		target = <0xffffffff>;

		__overlay__ {
			regulator-default-on = <0x1>;
			regulator-name = "vcama1";
			status = "okay";
		};
	};

	fragment@57 {
		target = <0xffffffff>;

		__overlay__ {
			regulator-default-on = <0x1>;
			regulator-name = "vcama2";
			status = "okay";
		};
	};

	fragment@58 {
		target = <0xffffffff>;

		__overlay__ {
			regulator-default-on = <0x1>;
			regulator-name = "vsim1";
			status = "okay";
		};
	};

	fragment@59 {
		target = <0xffffffff>;

		__overlay__ {
			regulator-default-on = <0x1>;
			regulator-name = "vsim2";
			status = "okay";
		};
	};

	fragment@6 {
		target = <0xffffffff>;

		__overlay__ {

			flashlightdefault {
				phandle = <0x1>;
			};

			flashlightenoutput0 {
				phandle = <0x3>;

				pins_cmd_dat {
					output-low;
					pinmux = <0x9800>;
					slew-rate = <0x1>;
				};
			};

			flashlightenoutput1 {
				phandle = <0x2>;

				pins_cmd_dat {
					output-high;
					pinmux = <0x9800>;
					slew-rate = <0x1>;
				};
			};

			flashlightseloutput0 {
				phandle = <0x5>;

				pins_cmd_dat {
					output-low;
					pinmux = <0x9900>;
					slew-rate = <0x1>;
				};
			};

			flashlightseloutput1 {
				phandle = <0x4>;

				pins_cmd_dat {
					output-high;
					pinmux = <0x9900>;
					slew-rate = <0x1>;
				};
			};
		};
	};

	fragment@60 {
		target = <0xffffffff>;

		__overlay__ {
			regulator-default-on = <0x1>;
			regulator-name = "vcamd";
			status = "okay";
		};
	};

	fragment@61 {
		target = <0xffffffff>;

		__overlay__ {
			regulator-default-on = <0x1>;
			regulator-name = "vcamio";
			status = "okay";
		};
	};

	fragment@62 {
		target = <0xffffffff>;

		__overlay__ {
			regulator-default-on = <0x1>;
			regulator-name = "vldo28";
			status = "okay";
		};
	};

	fragment@63 {
		target = <0xffffffff>;

		__overlay__ {
			status = "okay";
			vcama_main2-supply = <0xffffffff>;
			vcama_main3-supply = <0xffffffff>;
			vcama_sub-supply = <0xffffffff>;
			vcama_sub2-supply = <0xffffffff>;
			vcamaf-supply = <0xffffffff>;
			vcamd-supply = <0xffffffff>;
			vcamd_main2-supply = <0xffffffff>;
			vcamd_main3-supply = <0xffffffff>;
			vcamd_sub-supply = <0xffffffff>;
			vcamio-supply = <0xffffffff>;
			vcamio_main2-supply = <0xffffffff>;
			vcamio_main3-supply = <0xffffffff>;
			vcamio_sub-supply = <0xffffffff>;
			vcamio_sub2-supply = <0xffffffff>;
		};
	};

	fragment@64 {
		target = <0xffffffff>;

		__overlay__ {
			status = "okay";
			vtouch-supply = <0xffffffff>;
		};
	};

	fragment@65 {
		target = <0xffffffff>;

		__overlay__ {
			mediatek,kpd-hw-dl-key0 = <0x11>;
			mediatek,kpd-hw-dl-key1 = <0x0>;
			mediatek,kpd-hw-dl-key2 = <0x8>;
			mediatek,kpd-hw-factory-key = <0x0>;
			mediatek,kpd-hw-init-map = <0x72 0x0 0x0 0x0 0x0 0x0 0x0 0x0 0x0 0x0 0x0 0x0 0x0 0x0 0x0 0x0 0x0 0x0 0x0 0x0 0x0 0x0 0x0 0x0 0x0 0x0 0x0 0x0 0x0 0x0 0x0 0x0 0x0 0x0 0x0 0x0 0x0 0x0 0x0 0x0 0x0 0x0 0x0 0x0 0x0 0x0 0x0 0x0 0x0 0x0 0x0 0x0 0x0 0x0 0x0 0x0 0x0 0x0 0x0 0x0 0x0 0x0 0x0 0x0 0x0 0x0 0x0 0x0 0x0 0x0 0x0 0x0>;
			mediatek,kpd-hw-map-num = <0x48>;
			mediatek,kpd-hw-pwrkey = <0x8>;
			mediatek,kpd-hw-recovery-key = <0x11>;
			mediatek,kpd-hw-rstkey = <0x11>;
			mediatek,kpd-key-debounce = <0x400>;
			mediatek,kpd-pwkey-gpio-din = <0x0>;
			mediatek,kpd-pwrkey-eint-gpio = <0x0>;
			mediatek,kpd-sw-pwrkey = <0x74>;
			mediatek,kpd-sw-rstkey = <0x73>;
			mediatek,kpd-use-extend-type = <0x0>;
			status = "okay";
		};
	};

	fragment@66 {
		target = <0xffffffff>;

		__overlay__ {

			camdefault {
				phandle = <0x1a>;
			};

			camera0_mclk_2mA@gpio100 {
				phandle = <0x2e>;

				pins_cmd_dat {
					drive-strength = <0x2>;
					pinmux = <0x6401>;
				};
			};

			camera0_mclk_4mA@gpio100 {
				phandle = <0x2f>;

				pins_cmd_dat {
					drive-strength = <0x4>;
					pinmux = <0x6401>;
				};
			};

			camera0_mclk_6mA@gpio100 {
				phandle = <0x30>;

				pins_cmd_dat {
					drive-strength = <0x6>;
					pinmux = <0x6401>;
				};
			};

			camera0_mclk_8mA@gpio100 {
				phandle = <0x31>;

				pins_cmd_dat {
					drive-strength = <0x7>;
					pinmux = <0x6401>;
				};
			};

			camera0_mclk_gpio_mode@gpio100 {
				phandle = <0x2d>;

				pins_cmd_dat {
					drive-strength = <0x4>;
					pinmux = <0x6400>;
				};
			};

			camera0_rst_output_high@gpio102 {
				phandle = <0x1c>;

				pins_cmd_dat {
					output-high;
					pinmux = <0x6600>;
				};
			};

			camera0_rst_output_low@gpio102 {
				phandle = <0x1b>;

				pins_cmd_dat {
					output-low;
					pinmux = <0x6600>;
				};
			};

			camera0_vcama_output_high@gpio24 {
				phandle = <0x25>;

				pins_cmd_dat {
					output-high;
					pinmux = <0x1800>;
				};
			};

			camera0_vcama_output_low@gpio24 {
				phandle = <0x26>;

				pins_cmd_dat {
					output-low;
					pinmux = <0x1800>;
				};
			};

			camera1_mclk_2mA@gpio108 {
				phandle = <0x33>;

				pins_cmd_dat {
					drive-strength = <0x2>;
					pinmux = <0x6c01>;
				};
			};

			camera1_mclk_4mA@gpio108 {
				phandle = <0x34>;

				pins_cmd_dat {
					drive-strength = <0x4>;
					pinmux = <0x6c01>;
				};
			};

			camera1_mclk_6mA@gpio108 {
				phandle = <0x35>;

				pins_cmd_dat {
					drive-strength = <0x6>;
					pinmux = <0x6c01>;
				};
			};

			camera1_mclk_8mA@gpio108 {
				phandle = <0x36>;

				pins_cmd_dat {
					drive-strength = <0x7>;
					pinmux = <0x6c01>;
				};
			};

			camera1_mclk_gpio_mode@gpio108 {
				phandle = <0x32>;

				pins_cmd_dat {
					drive-strength = <0x4>;
					pinmux = <0x6c01>;
				};
			};

			camera1_mipi_switch_output_high@gpio3 {
				phandle = <0x29>;

				pins_cmd_dat {
					output-high;
					pinmux = <0x300>;
				};
			};

			camera1_mipi_switch_output_high@gpio4 {
				phandle = <0x2b>;

				pins_cmd_dat {
					output-high;
					pinmux = <0x400>;
				};
			};

			camera1_mipi_switch_output_low@gpio3 {
				phandle = <0x2a>;

				pins_cmd_dat {
					output-low;
					pinmux = <0x300>;
				};
			};

			camera1_mipi_switch_output_low@gpio4 {
				phandle = <0x2c>;

				pins_cmd_dat {
					output-low;
					pinmux = <0x400>;
				};
			};

			camera1_rst_output_high@gpio109 {
				phandle = <0x1e>;

				pins_cmd_dat {
					output-high;
					pinmux = <0x6d00>;
				};
			};

			camera1_rst_output_low@gpio109 {
				phandle = <0x1d>;

				pins_cmd_dat {
					output-low;
					pinmux = <0x6d00>;
				};
			};

			camera1_vcama_output_high@gpio24 {
				phandle = <0x27>;

				pins_cmd_dat {
					output-high;
					pinmux = <0x1800>;
				};
			};

			camera1_vcama_output_low@gpio24 {
				phandle = <0x28>;

				pins_cmd_dat {
					output-low;
					pinmux = <0x1800>;
				};
			};

			camera2_mclk_2mA@gpio108 {
				phandle = <0x38>;

				pins_cmd_dat {
					drive-strength = <0x2>;
					pinmux = <0x6c01>;
				};
			};

			camera2_mclk_4mA@gpio108 {
				phandle = <0x39>;

				pins_cmd_dat {
					drive-strength = <0x4>;
					pinmux = <0x6c01>;
				};
			};

			camera2_mclk_6mA@gpio108 {
				phandle = <0x3a>;

				pins_cmd_dat {
					drive-strength = <0x6>;
					pinmux = <0x6c01>;
				};
			};

			camera2_mclk_8mA@gpio108 {
				phandle = <0x3b>;

				pins_cmd_dat {
					drive-strength = <0x7>;
					pinmux = <0x6c01>;
				};
			};

			camera2_mclk_gpio_mode@gpio108 {
				phandle = <0x37>;

				pins_cmd_dat {
					drive-strength = <0x4>;
					pinmux = <0x6c00>;
				};
			};

			camera2_rst_output_high@gpio7 {
				phandle = <0x20>;

				pins_cmd_dat {
					output-high;
					pinmux = <0x700>;
				};
			};

			camera2_rst_output_low@gpio7 {
				phandle = <0x1f>;

				pins_cmd_dat {
					output-low;
					pinmux = <0x700>;
				};
			};

			camera3_mclk_2mA@gpio99 {
				phandle = <0x3d>;

				pins_cmd_dat {
					drive-strength = <0x2>;
					pinmux = <0x6301>;
				};
			};

			camera3_mclk_4mA@gpio99 {
				phandle = <0x3e>;

				pins_cmd_dat {
					drive-strength = <0x4>;
					pinmux = <0x6301>;
				};
			};

			camera3_mclk_6mA@gpio99 {
				phandle = <0x3f>;

				pins_cmd_dat {
					drive-strength = <0x6>;
					pinmux = <0x6301>;
				};
			};

			camera3_mclk_8mA@gpio99 {
				phandle = <0x40>;

				pins_cmd_dat {
					drive-strength = <0x7>;
					pinmux = <0x6301>;
				};
			};

			camera3_mclk_gpio_mode@gpio99 {
				phandle = <0x3c>;

				pins_cmd_dat {
					drive-strength = <0x4>;
					pinmux = <0x6300>;
				};
			};

			camera3_rst_output_high@gpio101 {
				phandle = <0x22>;

				pins_cmd_dat {
					output-high;
					pinmux = <0x6500>;
				};
			};

			camera3_rst_output_low@gpio101 {
				phandle = <0x21>;

				pins_cmd_dat {
					output-low;
					pinmux = <0x6500>;
				};
			};

			camera3_vcamd_output_high@gpio0 {
				phandle = <0x49>;

				pins_cmd_dat {
					output-high;
					pinmux = <0x0>;
				};
			};

			camera3_vcamd_output_low@gpio0 {
				phandle = <0x48>;

				pins_cmd_dat {
					output-low;
					pinmux = <0x0>;
				};
			};

			camera4_id_input_high@gpio79 {
				phandle = <0x47>;

				pins_cmd_dat {
					input-enable;
					pinmux = <0x4f00>;
				};
			};

			camera4_id_input_low@gpio79 {
				phandle = <0x46>;

				pins_cmd_dat {
					input-enable;
					pinmux = <0x4f00>;
				};
			};

			camera4_mclk_2mA@gpio111 {
				phandle = <0x42>;

				pins_cmd_dat {
					drive-strength = <0x2>;
					pinmux = <0x6f01>;
				};
			};

			camera4_mclk_4mA@gpio111 {
				phandle = <0x43>;

				pins_cmd_dat {
					drive-strength = <0x4>;
					pinmux = <0x6f01>;
				};
			};

			camera4_mclk_6mA@gpio111 {
				phandle = <0x44>;

				pins_cmd_dat {
					drive-strength = <0x6>;
					pinmux = <0x6f01>;
				};
			};

			camera4_mclk_8mA@gpio111 {
				phandle = <0x45>;

				pins_cmd_dat {
					drive-strength = <0x7>;
					pinmux = <0x6f01>;
				};
			};

			camera4_mclk_gpio_mode@gpio111 {
				phandle = <0x41>;

				pins_cmd_dat {
					drive-strength = <0x4>;
					pinmux = <0x6f00>;
				};
			};

			camera4_rst_output_high@gpio112 {
				phandle = <0x24>;

				pins_cmd_dat {
					output-high;
					pinmux = <0x7000>;
				};
			};

			camera4_rst_output_low@gpio112 {
				phandle = <0x23>;

				pins_cmd_dat {
					output-low;
					pinmux = <0x7000>;
				};
			};
		};
	};

	fragment@67 {
		target = <0xffffffff>;

		__overlay__ {
			cam0_enable_sensor = "ov13b10_ofilm_mipi_raw ov13b10_qtech_mipi_raw s5k3l6_qtech_mipi_raw";
			cam0_vcamaf-supply = <0xffffffff>;
			cam0_vcamd-supply = <0xffffffff>;
			cam0_vcamio-supply = <0xffffffff>;
			cam1_enable_sensor = "s5k4h7yx_ofilm_front_mipi_raw s5k4h7yx_qtech_front_mipi_raw ov8856_qtech_front_mipi_raw";
			cam1_vcamd-supply = <0xffffffff>;
			cam1_vcamio-supply = <0xffffffff>;
			cam2_enable_sensor = "s5k4h7yx_ofilm_ultra_mipi_raw s5k4h7yx_qtech_ultra_mipi_raw ov8856_qtech_ultra_mipi_raw";
			cam2_vcama-supply = <0xffffffff>;
			cam2_vcamd-supply = <0xffffffff>;
			cam2_vcamio-supply = <0xffffffff>;
			cam3_enable_sensor = "ov2180_ofilm_mipi_raw ov2180_qtech_mipi_raw";
			cam3_vcama-supply = <0xffffffff>;
			cam3_vcamio-supply = <0xffffffff>;
			cam4_enable_sensor = "gc5035_ofilm_mipi_raw gc5035_qtech_mipi_raw";
			cam4_vcama-supply = <0xffffffff>;
			cam4_vcamd-supply = <0xffffffff>;
			cam4_vcamio-supply = <0xffffffff>;
			pinctrl-0 = <0x1a>;
			pinctrl-1 = <0x1b>;
			pinctrl-10 = <0x24>;
			pinctrl-11 = <0x25>;
			pinctrl-12 = <0x26>;
			pinctrl-13 = <0x1a>;
			pinctrl-14 = <0x1a>;
			pinctrl-15 = <0x27>;
			pinctrl-16 = <0x28>;
			pinctrl-17 = <0x29>;
			pinctrl-18 = <0x2a>;
			pinctrl-19 = <0x2b>;
			pinctrl-2 = <0x1c>;
			pinctrl-20 = <0x2c>;
			pinctrl-21 = <0x2d>;
			pinctrl-22 = <0x2e>;
			pinctrl-23 = <0x2f>;
			pinctrl-24 = <0x30>;
			pinctrl-25 = <0x31>;
			pinctrl-26 = <0x32>;
			pinctrl-27 = <0x33>;
			pinctrl-28 = <0x34>;
			pinctrl-29 = <0x35>;
			pinctrl-3 = <0x1d>;
			pinctrl-30 = <0x36>;
			pinctrl-31 = <0x37>;
			pinctrl-32 = <0x38>;
			pinctrl-33 = <0x39>;
			pinctrl-34 = <0x3a>;
			pinctrl-35 = <0x3b>;
			pinctrl-36 = <0x3c>;
			pinctrl-37 = <0x3d>;
			pinctrl-38 = <0x3e>;
			pinctrl-39 = <0x3f>;
			pinctrl-4 = <0x1e>;
			pinctrl-40 = <0x40>;
			pinctrl-41 = <0x41>;
			pinctrl-42 = <0x42>;
			pinctrl-43 = <0x43>;
			pinctrl-44 = <0x44>;
			pinctrl-45 = <0x45>;
			pinctrl-46 = <0x46>;
			pinctrl-47 = <0x47>;
			pinctrl-48 = <0x48>;
			pinctrl-49 = <0x49>;
			pinctrl-5 = <0x1f>;
			pinctrl-6 = <0x20>;
			pinctrl-7 = <0x21>;
			pinctrl-8 = <0x22>;
			pinctrl-9 = <0x23>;
			pinctrl-names = "default", "cam0_rst0", "cam0_rst1", "cam1_rst0", "cam1_rst1", "cam2_rst0", "cam2_rst1", "cam3_rst0", "cam3_rst1", "cam4_rst0", "cam4_rst1", "cam0_vcama_on", "cam0_vcama_off", "cam0_vcamd_on", "cam0_vcamd_off", "cam1_vcama_on", "cam1_vcama_off", "cam_mipi_switch_en_1", "cam_mipi_switch_en_0", "cam_mipi_switch_sel_1", "cam_mipi_switch_sel_0", "cam0_mclk_off", "cam0_mclk_2mA", "cam0_mclk_4mA", "cam0_mclk_6mA", "cam0_mclk_8mA", "cam1_mclk_off", "cam1_mclk_2mA", "cam1_mclk_4mA", "cam1_mclk_6mA", "cam1_mclk_8mA", "cam2_mclk_off", "cam2_mclk_2mA", "cam2_mclk_4mA", "cam2_mclk_6mA", "cam2_mclk_8mA", "cam3_mclk_off", "cam3_mclk_2mA", "cam3_mclk_4mA", "cam3_mclk_6mA", "cam3_mclk_8mA", "cam4_mclk_off", "cam4_mclk_2mA", "cam4_mclk_4mA", "cam4_mclk_6mA", "cam4_mclk_8mA", "cam4_id_low", "cam4_id_high", "cam3_vcamd_off", "cam3_vcamd_on";
			status = "okay";
		};
	};

	fragment@7 {
		target = <0xffffffff>;

		__overlay__ {
			pinctrl-0 = <0x6>;
			pinctrl-1 = <0x7>;
			pinctrl-2 = <0x8>;
			pinctrl-3 = <0x9>;
			pinctrl-4 = <0xa>;
			pinctrl-5 = <0xb>;
			pinctrl-names = "default", "state_eint_as_int", "state_eint_output0", "state_eint_output1", "state_rst_output0", "state_rst_output1";
			status = "okay";
			tpd-filter-custom-prameters = <0x0 0x0 0x0 0x0 0x0 0x0 0x0 0x0 0x0 0x0 0x0 0x0>;
			tpd-filter-custom-speed = <0x0 0x0 0x0>;
			tpd-filter-enable = <0x0>;
			tpd-filter-pixel-density = <0xa8>;
			tpd-key-dim-local = <0x5a 0x373 0x64 0x28 0xe6 0x373 0x64 0x28 0x172 0x373 0x64 0x28 0x0 0x0 0x0 0x0>;
			tpd-key-local = <0x8b 0xac 0x9e 0x0>;
			tpd-key-num = <0x3>;
			tpd-max-touch-num = <0xa>;
			tpd-resolution = <0x438 0x924>;
			use-tpd-button = <0x0>;
		};
	};

	fragment@8 {
		target = <0xffffffff>;

		__overlay__ {

			eint0default {
				phandle = <0x6>;
			};

			eint1default {
				phandle = <0x52>;
			};

			eint@0 {
				phandle = <0x7>;

				pins_cmd_dat {
					bias-disable;
					pinmux = <0x100>;
					slew-rate = <0x0>;
				};
			};

			eintoutput0 {
				phandle = <0x8>;

				pins_cmd_dat {
					output-low;
					pinmux = <0x100>;
					slew-rate = <0x1>;
				};
			};

			eintoutput1 {
				phandle = <0x9>;

				pins_cmd_dat {
					output-high;
					pinmux = <0x100>;
					slew-rate = <0x1>;
				};
			};

			rstoutput0 {
				phandle = <0xa>;

				pins_cmd_dat {
					output-low;
					pinmux = <0x5c00>;
					slew-rate = <0x1>;
				};
			};

			rstoutput1 {
				phandle = <0xb>;

				pins_cmd_dat {
					output-high;
					pinmux = <0x5c00>;
					slew-rate = <0x1>;
				};
			};
		};
	};

	fragment@9 {
		target = <0xffffffff>;

		__overlay__ {
			status = "okay";

			nxp@28 {
				compatible = "nq-nci";
				interrupt-names = "irq_nfc";
				interrupt-parent = <0xffffffff>;
				interrupts = <0x9 0x4 0x9 0x0>;
				nq-clkreq = <0xffffffff 0xb 0x0>;
				nq-firm = <0xffffffff 0x11 0x0>;
				nq-irq = <0xffffffff 0x9 0x0>;
				nq-ven = <0xffffffff 0x9f 0x0>;
				reg = <0x28>;
			};
		};
	};
};
